## arch/arm/mach-sprd/Kconfig
```kconfig
if ARCH_SPRD

choice
	prompt "SpreadTrum UNISOC platfrom select"

config ARCH_SHARKL3
	bool "SharkL3 Platform"
	select ARM64
	help
	  SpreadTrum Unisoc SharkL3 Platform

endchoice

source arch/arm/mach-sprd/sharkl3/Kconfig

endif
```

## arch/arm/mach-sprd/sharkl3/Kconfig
```kconfig
if ARCH_SHARKL3

choice
	prompt "Select an SoC based on Sharkl3 platfoem"

config ARCH_SC9863A
	bool "UNISOC Sharkl3 SC9863A"
	help
	  SpreadTrum Sharkl3 SoC SC9863A.
	  Features:
	    - 8-core Cortex-A55 CPU @ 1.6GHz
	    - Imagination PowerVR GE8300 GPU
	    - LPDDR3@933MHz or LPDDR4x@1333MHz
	    - eMMC 5.1
	    - Cat.7 LTE modem
	    - WiFi-5, BT, GNSS, FM

endchoice

if ARCH_SC9863A

choice
	prompt "Select a board based on SC9863A"

config TARGET_ALLDOCUBE_T1011S
	bool "ALLDOCUBE iPlay20(T1011S) tablet"
	select LINUX_KERNEL_IMAGE_HEADER
	help
	  ALLDOCUBE iPlay20 tablet.
	    - SoC: SC9863A
	    - Storage: 6 GiB LPDDR4 RAM + 128 GiB eMMC 5.1
	    - Display: 10.1' 1920x1200 IPS LCD
	    - Battery: 6000 mAh

endchoice

endif

source board/alldocube/t1011s/Kconfig

endif
```

## board/alldocube/t1011s/Kconfig
```kconfig
if TARGET_ALLDOCUBE_T1011S

config SYS_BOARD
	default "t1011s"

config SYS_VENDOR
	default "alldocube"

config SYS_SOC
	default "SC9863A"

config SYS_CONFIG_NAME
	default "alldocube-t1011s"

config LNX_KRNL_IMG_TEXT_OFFSET_BASE
	default 0x80000000

endif
```

## board/hisilicon/hi3798mv2x/Kconfig
```kconfig
if TARGET_HI3798MV2X

config SYS_BOARD
	default "hi3798mv2x"

config SYS_VENDOR
	default "hisilicon"

config SYS_SOC
	default "hi3798mv200"

config SYS_CONFIG_NAME
	default "hi3798mv2x"

endif
```

## board/skyworth/hc2910-2aghd05/Kconfig
```kconfig
if TARGET_HI3798MV2X

config SYS_BOARD
	default "hc2910-2aghd05"

config SYS_VENDOR
	default "skyworth"

config SYS_SOC
	default "hi3798mv2x"

config SYS_CONFIG_NAME
	default "hc2910-2aghd05"

endif
```

## board/skyworth/hc2910-2aghd07/Kconfig
```kconfig
if TARGET_HC2910_2AGHD07

config SYS_BOARD
	default "hc2910-2aghd07"

config SYS_VENDOR
	default "skyworth"

config SYS_SOC
	default "hi3798mv200"

config SYS_CONFIG_NAME
	default "hc2910-2aghd07"

endif
```

## configs/hc2910_2aghd05_defconfig
```kconfig
CONFIG_ARM=y
CONFIG_POSITION_INDEPENDENT=y
CONFIG_ARCH_HISTB=y
CONFIG_TEXT_BASE=0x00000000
CONFIG_SYS_MALLOC_LEN=0x2000000
CONFIG_SYS_MALLOC_F_LEN=0x4000
CONFIG_NR_DRAM_BANKS=2
CONFIG_ENV_SIZE=0x10000
CONFIG_ENV_OFFSET=0x0
CONFIG_DEFAULT_DEVICE_TREE="hi3798mv200-hc2910-2aghd05"
CONFIG_IDENT_STRING="HC2910"
CONFIG_SYS_LOAD_ADDR=0x800000
# CONFIG_EXPERT is not set
CONFIG_BOOTSTD_FULL=y
CONFIG_SYS_CBSIZE=512
CONFIG_SYS_PBSIZE=537
# CONFIG_DISPLAY_CPUINFO is not set
# CONFIG_HUSH_OLD_PARSER is not set
CONFIG_HUSH_MODERN_PARSER=y
CONFIG_SYS_PROMPT="HC2910# "
# CONFIG_BOOTM_PLAN9 is not set
# CONFIG_BOOTM_RTEMS is not set
# CONFIG_BOOTM_VXWORKS is not set
CONFIG_CMD_NVEDIT_INFO=y
CONFIG_CMD_MEMINFO=y
CONFIG_CMD_GPT=y
CONFIG_CMD_GPT_RENAME=y
CONFIG_CMD_LSBLK=y
CONFIG_CMD_MBR=y
CONFIG_CMD_MMC=y
CONFIG_CMD_POWEROFF=y
CONFIG_CMD_USB=y
CONFIG_CMD_WDT=y
CONFIG_CMD_CAT=y
CONFIG_CMD_SYSBOOT=y
CONFIG_CMD_EROFS=y
CONFIG_CMD_EXT4_WRITE=y
CONFIG_MMC_SPEED_MODE_SET=y
# CONFIG_ISO_PARTITION is not set
CONFIG_PARTITION_TYPE_GUID=y
CONFIG_ENV_IS_IN_MMC=y
CONFIG_SYS_RELOC_GD_ENV_ADDR=y
CONFIG_SYS_MMC_ENV_PART=1
CONFIG_NET_RANDOM_ETHADDR=y
CONFIG_NETCONSOLE=y
CONFIG_CLK=y
CONFIG_CLK_CCF=y
CONFIG_CLK_HISI=y
CONFIG_COMMON_CLK_HI3798MV200=y
# CONFIG_GPIO is not set
# CONFIG_I2C is not set
# CONFIG_INPUT is not set
CONFIG_MMC_DW=y
CONFIG_MMC_DW_K3=y
CONFIG_DM_MDIO=y
CONFIG_HIFEMAC_ETH=y
CONFIG_HIFEMAC_MDIO=y
CONFIG_PHY=y
CONFIG_PHY_HISI_INNO_USB2=y
CONFIG_DM_REGULATOR=y
CONFIG_USB=y
CONFIG_USB_EHCI_HCD=y
CONFIG_USB_EHCI_GENERIC=y
CONFIG_WATCHDOG_TIMEOUT_MSECS=30000
CONFIG_WDT=y
CONFIG_WDT_SP805=y
CONFIG_FS_BTRFS=y
CONFIG_FAT_WRITE=y
# CONFIG_EFI_LOADER is not set
```

## drivers/clk/hisilicon/Kconfig
```kconfig
# SPDX-License-Identifier: GPL-2.0-only

if CLK_HISI
config COMMON_CLK_HI3798MV200
	tristate "Hi3798MV200 CRG Driver"
	select RESET_HISILICON
	depends on ARCH_HISTB
	help
	  Build the CRG driver for Hi3798MV200.

endif
```

## drivers/pinctrl/hisilicon/Kconfig
```kconfig
config PINCTRL_HISILICON
	bool

config PINCTRL_HISTB
	bool "HiSilicon HiSTB pinctrl framework"
	depends on PINCTRL
	select PINCTRL_HISILICON
	imply PINCONF
	help
	  Support HiSTB SoCs IOCONFIG module

menu "HiSTB pinctrl drivers"
	depends on PINCTRL_HISTB

config PINCTRL_HI3798MV2X
	bool "HiSilicon Hi3798MV2X pinctrl driver"
	depends on ARCH_HI3798MV2X
	help
	  Support IOCONFIG on Hi3798MV2X SoCs

endmenu
```

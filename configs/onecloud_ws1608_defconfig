## configs/onecloud_ws1608_defconfig
```kconfig
CONFIG_ARM=y
CONFIG_SYS_BOARD="onecloud-ws1608"
CONFIG_POSITION_INDEPENDENT=y
# CONFIG_USE_ARCH_MEMCPY is not set
# CONFIG_USE_ARCH_MEMSET is not set
CONFIG_ARCH_MESON=y
CONFIG_SYS_MALLOC_F_LEN=0x100000
CONFIG_NR_DRAM_BANKS=2
CONFIG_HAS_CUSTOM_SYS_INIT_SP_ADDR=y
CONFIG_CUSTOM_SYS_INIT_SP_ADDR=0x3d000000
CONFIG_ENV_SIZE=0x8000
CONFIG_ENV_OFFSET=0x100000
CONFIG_DM_GPIO=y
CONFIG_DEFAULT_DEVICE_TREE="amlogic/meson8b-onecloud-ws1608"
CONFIG_OF_LIBFDT_OVERLAY=y
CONFIG_DM_RESET=y
CONFIG_MESON_M8B=y
CONFIG_SYS_BOOTM_LEN=0x4000000
CONFIG_SYS_LOAD_ADDR=0x12000000
CONFIG_IDENT_STRING="onecloud-ws1608"
CONFIG_PHYS_64BIT=y
# CONFIG_EFI_LOADER is not set
CONFIG_FIT=y
CONFIG_FIT_SIGNATURE=y
CONFIG_FIT_VERBOSE=y
CONFIG_BOOTSTD_DEFAULTS=y
# CONFIG_BOOTMETH_VBE is not set
CONFIG_LEGACY_IMAGE_FORMAT=y
# CONFIG_DISTRO_DEFAULTS is not set
# CONFIG_ARCH_FIXUP_FDT_MEMORY is not set
# CONFIG_DISPLAY_CPUINFO is not set
CONFIG_LAST_STAGE_INIT=y
# CONFIG_HUSH_OLD_PARSER is not set
CONFIG_HUSH_MODERN_PARSER=y
CONFIG_SYS_PROMPT="ws1608# "
CONFIG_SYS_MAXARGS=32
# CONFIG_CMD_IMI is not set
CONFIG_CMD_LZMADEC=y
CONFIG_CMD_UNLZ4=y
CONFIG_CMD_UNZIP=y
CONFIG_CMD_CLK=y
CONFIG_CMD_GPIO=y
# CONFIG_CMD_LOADS is not set
CONFIG_CMD_MMC=y
CONFIG_CMD_USB=y
CONFIG_CMD_WDT=y
# CONFIG_CMD_SETEXPR is not set
CONFIG_CMD_SYSBOOT=y
CONFIG_CMD_REGULATOR=y
CONFIG_CMD_SQUASHFS=y
# CONFIG_CMD_CYCLIC is not set
# CONFIG_CMD_MESON is not set
CONFIG_OF_CONTROL=y
CONFIG_OF_UPSTREAM=y
CONFIG_ENV_IS_IN_MMC=y
CONFIG_SYS_RELOC_GD_ENV_ADDR=y
CONFIG_SYS_MMC_ENV_PART=1
CONFIG_NETCONSOLE=y
CONFIG_NET_RANDOM_ETHADDR=y
CONFIG_CLK_CCF=y
# CONFIG_I2C is not set
CONFIG_MMC_MESON_MX=y
CONFIG_PHY_REALTEK=y
CONFIG_ETH_DESIGNWARE_MESON8B=y
CONFIG_PHY=y
CONFIG_MESON_GXBB_USB_PHY=y
CONFIG_PINCTRL=y
CONFIG_PINCTRL_MESON_M8B=y
CONFIG_POWER_DOMAIN=y
CONFIG_MESON_EE_POWER_DOMAIN=y
CONFIG_DM_REGULATOR=y
CONFIG_DM_REGULATOR_FIXED=y
CONFIG_DM_REGULATOR_GPIO=y
CONFIG_MESON_SERIAL=y
CONFIG_SYSINFO=y
CONFIG_SYSINFO_SMBIOS=y
CONFIG_SYSRESET=y
CONFIG_SYSRESET_WATCHDOG=y
CONFIG_SYSRESET_WATCHDOG_AUTO=y
CONFIG_TIMER=y
CONFIG_MESON_TIMER=y
CONFIG_USB=y
CONFIG_USB_DWC2=y
CONFIG_USB_KEYBOARD=y
CONFIG_USB_KEYBOARD_FN_KEYS=y
CONFIG_VIDEO=y
# CONFIG_VIDEO_BPP8 is not set
# CONFIG_VIDEO_BPP16 is not set
CONFIG_VIDEO_ANSI=y
CONFIG_SYS_WHITE_ON_BLACK=y
CONFIG_VIDEO_MESON=y
CONFIG_VIDEO_DT_SIMPLEFB=y
CONFIG_SPLASH_SCREEN=y
CONFIG_SPLASH_SCREEN_ALIGN=y
CONFIG_VIDEO_BMP_RLE8=y
CONFIG_BMP_16BPP=y
CONFIG_BMP_24BPP=y
CONFIG_BMP_32BPP=y
CONFIG_WDT_MESON_MX=y
CONFIG_FAT_WRITE=y
CONFIG_FAT_RENAME=y
CONFIG_HEXDUMP=y
CONFIG_TOOLS_UCLPACK=y
```
